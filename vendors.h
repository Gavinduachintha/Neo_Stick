#pragma once
#include <stdint.h>
#include <pgmspace.h>

// Small OUI table for the WiFi detail screen. Not exhaustive — unknown
// prefixes show as UNKNOWN, locally-administered (randomised) as RANDOMISED.

struct OuiEntry {
    uint8_t oui[3];
    const char* name;
};

const OuiEntry OUI_TABLE[] PROGMEM = {
    {{0x24, 0x0A, 0xC4}, "ESPRESSIF"},
    {{0x30, 0xAE, 0xA4}, "ESPRESSIF"},
    {{0x84, 0xCC, 0xA8}, "ESPRESSIF"},
    {{0xA4, 0xCF, 0x12}, "ESPRESSIF"},
    {{0x3C, 0x71, 0xBF}, "ESPRESSIF"},
    {{0xB8, 0x27, 0xEB}, "RASPBERRY PI"},
    {{0xDC, 0xA6, 0x32}, "RASPBERRY PI"},
    {{0xE4, 0x5F, 0x01}, "RASPBERRY PI"},
    {{0x50, 0xC7, 0xBF}, "TP-LINK"},
    {{0xC0, 0x25, 0xE9}, "TP-LINK"},
    {{0x98, 0xDA, 0xC4}, "TP-LINK"},
    {{0x60, 0x32, 0xB1}, "TP-LINK"},
    {{0x28, 0x6C, 0x07}, "XIAOMI"},
    {{0x64, 0x09, 0x80}, "XIAOMI"},
    {{0xF8, 0xA4, 0x5F}, "XIAOMI"},
    {{0x3C, 0x22, 0xFB}, "APPLE"},
    {{0xF0, 0x18, 0x98}, "APPLE"},
    {{0xA4, 0x83, 0xE7}, "APPLE"},
    {{0x8C, 0xF5, 0xA3}, "SAMSUNG"},
    {{0x50, 0x01, 0xBB}, "SAMSUNG"},
    {{0xA8, 0x9F, 0xBA}, "SAMSUNG"},
    {{0x00, 0xE0, 0xFC}, "HUAWEI"},
    {{0x48, 0x46, 0xFB}, "HUAWEI"},
    {{0xE0, 0x24, 0x7F}, "HUAWEI"},
    {{0x20, 0xE5, 0x2A}, "NETGEAR"},
    {{0xA0, 0x40, 0xA0}, "NETGEAR"},
    {{0x24, 0xA4, 0x3C}, "UBIQUITI"},
    {{0x78, 0x8A, 0x20}, "UBIQUITI"},
    {{0xFC, 0xEC, 0xDA}, "UBIQUITI"},
    {{0x1C, 0x7E, 0xE5}, "D-LINK"},
    {{0x28, 0x10, 0x7B}, "D-LINK"},
    {{0x04, 0xD4, 0xC4}, "ASUS"},
    {{0x2C, 0xFD, 0xA1}, "ASUS"},
    {{0x00, 0x1A, 0xA1}, "CISCO"},
    {{0x58, 0x97, 0xBD}, "CISCO"},
    {{0x4C, 0x5E, 0x0C}, "MIKROTIK"},
    {{0x6C, 0x3B, 0x6B}, "MIKROTIK"},
    {{0xE4, 0x8D, 0x8C}, "MIKROTIK"},
    {{0xF4, 0xF5, 0xD8}, "GOOGLE"},
    {{0x54, 0x60, 0x09}, "GOOGLE"},
    {{0x74, 0xC2, 0x46}, "AMAZON"},
    {{0xFC, 0x65, 0xDE}, "AMAZON"},
    {{0xC8, 0x3A, 0x35}, "TENDA"},
    {{0x50, 0x2B, 0x73}, "TENDA"},
    {{0x00, 0x19, 0xC6}, "ZTE"},
    {{0x34, 0x4B, 0x50}, "ZTE"},
};

const int OUI_COUNT = sizeof(OUI_TABLE) / sizeof(OUI_TABLE[0]);

inline const char* lookupVendor(const uint8_t* mac) {
    if (mac[0] & 0x02) return "RANDOMISED";
    for (int i = 0; i < OUI_COUNT; i++) {
        OuiEntry e;
        memcpy_P(&e, &OUI_TABLE[i], sizeof(e));
        if (e.oui[0] == mac[0] && e.oui[1] == mac[1] && e.oui[2] == mac[2]) {
            return e.name;
        }
    }
    return "UNKNOWN";
}
